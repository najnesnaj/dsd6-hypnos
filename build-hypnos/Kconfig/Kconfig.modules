## build-hypnos/Kconfig/Kconfig.shield
```kconfig
osource "/usr/src/pinetime-hypnos/app/hypnos/../boards/shields/*/Kconfig.shield"
osource "/usr/src/pinetime-hypnos/zephyr/boards/shields/*/Kconfig.shield"
```

## build-hypnos/Kconfig/Kconfig.shield.defconfig
```kconfig
osource "/usr/src/pinetime-hypnos/app/hypnos/../boards/shields/*/Kconfig.defconfig"
osource "/usr/src/pinetime-hypnos/zephyr/boards/shields/*/Kconfig.defconfig"
```

## build-hypnos/Kconfig/Kconfig.soc.arch
```kconfig
osource "/usr/src/pinetime-hypnos/zephyr/soc/$(ARCH)/Kconfig"
osource "/usr/src/pinetime-hypnos/zephyr/soc/$(ARCH)/*/Kconfig"
```

## build/Kconfig/Kconfig.shield
```kconfig
osource "/usr/src/dsd6-hypnos/app/hypnos/../boards/shields/*/Kconfig.shield"
osource "/usr/src/dsd6-hypnos/zephyr/boards/shields/*/Kconfig.shield"
```

## build/Kconfig/Kconfig.shield.defconfig
```kconfig
osource "/usr/src/dsd6-hypnos/app/hypnos/../boards/shields/*/Kconfig.defconfig"
osource "/usr/src/dsd6-hypnos/zephyr/boards/shields/*/Kconfig.defconfig"
```

## build/Kconfig/Kconfig.soc.arch
```kconfig
osource "/usr/src/dsd6-hypnos/zephyr/soc/$(ARCH)/Kconfig"
osource "/usr/src/dsd6-hypnos/zephyr/soc/$(ARCH)/*/Kconfig"
```
